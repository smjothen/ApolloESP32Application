## components/calibration/Kconfig
```kconfig
menu "MID Calibration"

	config CAL_KEY
		string "Secret calibration key for communication with app"
		default "6ea2ac08d055bcf09ae52d570315f43e"

	config CAL_VERIFY_TIMES
		int "How many times to run each verification"
		default 1
	
	config CAL_SERVER_IP
		string "Multicast IP of calibration server"
		default "232.10.11.12"

	config CAL_SERVER_PORT
		int "Port of calibration server"
		default 3333

	config CAL_TIMEOUT
		int "Timeout for sending state data to server (ms)"
		default 1000
		
endmenu
```

## components/ocpp/Kconfig
```kconfig
menu "OCPP"

menu "Core profile"

config OCPP_VENDOR_ID
       string "Vendor id"
       help
	Vendor id is used by OCPP to define vendor specific implementations. It is used by StatusNotification.req
	when error code is set to "OtherError" and "vendorErrorCode" is used. It is also used by DataTransfer.req.
       default "zaptec"

config OCPP_URL_MAX_LENGTH
       int "Maximum length of the of OCPP connection URL"
       help
	Length of the OCPP URL where the OCPP 1.6j websocket endpoint is located. This length is without CBID.
       default 2048
       range 8 4000 # Max range is currently 4000 due to nvs string limitations.

config OCPP_MAX_TRANSACTION_QUEUE_SIZE
       int "Size of transaction queue"
       help
	Maximum number of transaction queued without being stored on file
       default 20

config OCPP_MAX_TRANSACTION_FILES
       int "Maximum transaction files"
       help
	Maximum number of unique transactions that can be stored on file while offline.
	Transaction files are deleted when a StopTransaction.conf is received or failed too many times.
       default 100

config OCPP_MAX_TRANSACTION_FILE_SIZE
       int "Maximum transaction file size"
       help
	Maximum size of each unique transaction file size. Only meter values may be rejected due to space limitations.
       default 65536

config OCPP_AUTH_CACHE_MAX_LENGTH
       int "Equivalent to LocalAuthListMaxLength for auth cache"
       help
	Maximum number of identifications that can be stored in the Authorization Cache
       default 128

config OCPP_FILE_PATH
       string "File path for local storage"
       help
	Base path where ocpp component can store both necessary and optional files like smart charging
	profiles, authorization cache and authorization list.
       default "/files"

config OCPP_CONNECTOR_PHASE_ROTATION_MAX_LENGTH # 9.1.8
       int "ConnectorPhaseRotationMaxLength"
       help
	Maximum number of items in a ConnectorPhaseRotation Configuration Key.
       default 1

config OCPP_GET_CONFIGURATION_MAX_KEYS # 9.1.9
       int "GetConfigurationMaxKeys"
       help
	Maximum number of requested configuration keys in a GetConfiguration.req PDU.
       default 62

config OCPP_METER_VALUES_ALIGNED_DATA_MAX_LENGTH # 9.1.16
       int "MeterValuesAlignedDataMaxLength"
       help
	Maximum number of items in a MeterValuesAlignedData Configuration Key.
       default 6

config OCPP_METER_VALUES_SAMPLED_DATA_MAX_LENGTH # 9.1.18
       int "MeterValuesSampledDataMaxLength"
       help
	Maximum number of items in a MeterValuesSampledData Configuration Key.
       default 6

config OCPP_NUMBER_OF_CONNECTORS # 9.1.21
       int "NumberOfConnectors"
       help
	The number of physical charging connectors of this Charge Point.
       default 1

config OCPP_STOP_TRANSACTION_MAX_METER_VALUES # errata v4.0 as 9.1.23
       int "StopTransactionMaxMeterValues"
       help
	The maximum amout of meter values that this Charge Poit ca report i the trasactioData field of a
	StopTrasactio.req.  Whe the amout of meter values collected for a trasactio exceeds:
	StopTrasactioMaxMeterValues, the Charge Poit MAY drop itermediate meter values, to prevet ruig out of
	memory, or beig uable to sed the StopTrasactio.req (overruig the trasmit buffer size). The Start ad
	Stop meter values SHALL ever be dropped.  Whe the Charge Poit eeds to store more itermediate values
	tha: StopTrasactioMaxMeterValues, it is RECOMMEDED ot to start droppig messages from the start, or
	stop storig ew values. It is better to drop itermediate messages first (1st message, 3th message, 5th
	message etc.), or uses a smart algorithm, for example remove duplicate values first. etc
       default 512

config OCPP_STOP_TXN_ALIGNED_DATA_MAX_LENGTH # 9.1.26
       int "StopTxnAlignedDataMaxLength"
       help
	Maximum number of items in a StopTxnAlignedData Configuration Key.
       default 6

config OCPP_STOP_TXN_SAMPLED_DATA_MAX_LENGTH # 9.1.28
       int "StopTxnSampledDataMaxLength"
       help
	Maximum number of items in a StopTxnSampledData Configuration Key.
       default 6

config OCPP_SUPPORTED_FEATURE_PROFILES # 9.1.29
       string "SupportedFeatureProfiles"
       help
	A list of supported Feature Profiles. Possible profile identifiers: Core,
	FirmwareManagement, LocalAuthListManagement, Reservation, SmartCharging and RemoteTrigger.
       default "Core,Firmware Management,Local Auth List Management,Reservation,Smart Charging,Remote Trigger"

config OCPP_SUPPORTED_FEATURE_PROFILES_MAXL_ENGTH # 9.1.30
       int "SupportedFeatureProfilesMaxLength"
       help
	Maximum number of items in a SupportedFeatureProfiles Configuration Key.
       default 6
endmenu

menu "Firmware Management"

config OCPP_SUPPORTED_FILE_TRANSFER_PROTOCOLS # errata 3.88
       string "SupportedFileTransferProtocols"
       help
	This configuration key tells the Central System which file transfer protocols are supported
	by the Charge Point. Allowed values:'FTP', 'FTPS', 'HTTP' and 'HTTPS'.
       default "HTTP,HTTPS"
endmenu
menu "Local Auth List Management Profile"

config OCPP_LOCAL_AUTH_LIST_MAX_LENGTH # 9.2.2
       int "LocalAuthListMaxLength"
       help
        Maximum number of identifications that can be stored in the Local Authorization List
       default 1024

config OCPP_SEND_LOCAL_LIST_MAX_LENGTH # 9.2.3
       int "SendLocalListMaxLength"
       help
	Maximum number of identifications that can be send in a single SendLocalList.req
       default 255

endmenu

menu "Reservation Profile"

config OCPP_RESERVE_CONNECTOR_ZERO_SUPPORTED # 9.3.1
       bool "ReserveConnectorZeroSupported"
       help
	If this configuration key is present and set to true: Charge Point support reservations on
	connector 0.
       default y
endmenu

menu "Smart Charging Profile"

config OCPP_CHARGE_PROFILE_MAX_STACK_LEVEL # 9.4.1
       int "ChargeProfileMaxStackLevel"
       help
	Max StackLevel of a ChargingProfile. The number defined also indicates the max allowed
	number of installed charging schedules per Charging Profile Purposes.
       default 8

config OCPP_CHARGING_SCHEDULE_ALLOWED_CHARGING_RATE_UNIT # 9.4.2
       string "ChargingScheduleAllowedChargingRateUnit"
       help
	A list of supported quantities for use in a ChargingSchedule. Allowed values: 'Current' and 'Power'
       default "Current"

config OCPP_CHARGING_SCHEDULE_MAX_PERIODS # 9.4.3
       int "ChargingScheduleMaxPeriods"
       help
	Maximum number of periods that may be defined per ChargingSchedule.
       default 32

config OCPP_CONNECTOR_SWITCH_3_TO_1_PHASE_SUPPORTED # 9.4.4
       bool "ConnectorSwitch3to1PhaseSupported"
       help
	If defined and true, this Charge Point support switching from 3 to 1 phase during a Transaction.
       default n

config OCPP_MAX_CHARGING_PROFILES_INSTALLED # 9.4.5
       int "MaxChargingProfilesInstalled"
       help
	Maximum number of Charging profiles installed at a time
       default 24

endmenu

menu "Security whitepaper"

config OCPP_ADDITIONAL_ROOT_CERTIFICATE_CHECK # 7.1
       bool "AdditionalRootCertificateCheck"
       help
        When set to true, only one certificate (plus a temporarily fallback certificate) of
        certificateType CentralSystemRootCertificate is allowed to be installed at a time. When
        installing a new Central System Root certificate, the new certificate SHALL replace the old
        one AND the new Central System Root Certificate MUST be signed by the old Central System
        Root Certificate it is replacing.  This configuration key is required unless only "security
        profile 1 - Unsecured Transport with Basic Authentication" is implemented. Please note that
        security profile 1 SHOULD only be used in trusted networks.  Note: When using this
        additional security mechanism please be aware that the Charge Point needs to perform a full
        certificate chain verification when the new Central System Root certificate is being
        installed. However, once the old Central System Root certificate is set as the fallback
        certificate, the Charge Point needs to perform a partial certificate chain verification when
        verifying the server certificate during the TLS handshake. Otherwise the verification will
        fail once the old Central System Root (fallback) certificate is either expired or removed.
       default n

config OCPP_CERTIFICATE_SIGNED_MAX_CHAIN_SIZE # 7.3
       int "CertificateSignedMaxChainSize"
       help
        This configuration key can be used to limit the size of the 'certificateChain' field from
	the CertificateSigned.req PDU. The value of this configuration key has a maximum limit of
	10.000 characters.
       default 0
       range 0 10000

config OCPP_CERTIFICATE_STORE_MAX_LENGTH # 7.4
       int "CertificateStoreMaxLength"
       help
        Maximum number of Root/CA certificates that can be installed in the Charge Point.
       default 0
endmenu

menu "Debug"

config OCPP_TRACE_MEMORY
       bool "Enable memory tracing for component"
       depends on HEAP_TRACING
       default n

choice OCPP_TRACE_MEMORY_FOR
       bool "Trace type"
       depends on OCPP_TRACE_MEMORY
       default OCPP_TRACE_MEMORY_FOR_REQ_CB

       config OCPP_TRACE_MEMORY_FOR_REQ_CB
       	      bool "Enable memory leak info for .req callbacks"
       	      help
	       Calls heap_trace_start before the callback is called for each .req message sent and calls
	       heap_trace_stop and heap_trace_dump after the callback returns.

       config OCPP_TRACE_MEMORY_FOR_REQ_SEND
       	      bool "Enable memory leak info for .req sending"
       	      help
	       Calls heap_trace_start when message is enqueued and calls heap_trace_stop and heap_trace_dump
	       after related .conf has been handled.
endchoice
endmenu
endmenu
```

## components/zaptec_cloud/Kconfig
```kconfig
menu "Zaptec cloud"
     config ZAPTEC_CLOUD_USE_DEVELOPMENT_URL
     	    bool
     	    default N

     config ZAPTEC_CLOUD_URL_MAIN_MQTT
       	    string "MQTT URL to use for development builds"
       	    default "zapcloud.azure-devices.net"

     config ZAPTEC_CLOUD_URL_DEVELOPMENT_MQTT
     	    string "MQTT URL to use for production builds"
	    default "zap-d-iothub.azure-devices.net"
endmenu
```
